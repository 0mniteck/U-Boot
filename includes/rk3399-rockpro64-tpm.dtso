/dts-v1/;
/plugin/;

/ {
....	/* various properties for loader use; i.e. part id etc. */
fragment@0 {
	target = <&spi1>;
	__overlay__ {
		status = "okay";
		#address-cells = <1>;
		#size-cells = <0>;

		tpm: tpm@10 {
			compatible = "infineon,slb9670", "tis,tpm2-spi", "tcg,tpm_tis-spi";
			reg = <0x10>;
			spi-max-frequency = <38000000>;
			};
	};
};
};
