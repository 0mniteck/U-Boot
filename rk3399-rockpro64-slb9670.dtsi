/*
 * Device Tree overlay for the Infineon SLB9670 Trusted Platform Module add-on
 * boards, which can be used as a secure key storage and hwrng.
 * available as "Iridium SLB9670" by Infineon and "LetsTrust TPM" by pi3g.
 */

/ {
	compatible = "pine64,rockpro64-v2.1", "pine64,rockpro64", "rockchip,rk3399";
	fragment@0 {
		target = <&spi1>;
		__overlay__ {
			compatible = "spi-gpio";
			pinctrl-names = "default";
			pinctrl-0 = <&spi1>;
			gpio-sck = <&gpio0 11 0>;
			gpio-mosi = <&gpio0 10 0>;
			gpio-miso = <&gpio0 9 0>;
			cs-gpios = <&gpio0 7 1>;
			spi-delay-us = <0>;
			#address-cells = <1>;
			#size-cells = <0>;
			status = "okay";

			/* for kernel driver */
			sck-gpios = <&gpio0 11 0>;
			mosi-gpios = <&gpio0 10 0>;
			miso-gpios = <&gpio0 9 0>;
			num-chipselects = <1>;

			slb9670: slb9670@0 {
				compatible = "infineon,slb9670", "tis,tpm2-spi", "tcg,tpm_tis-spi";
				reg = <0>;
				gpio-reset = <&gpio0 24 1>;
				#address-cells = <1>;
				#size-cells = <0>;
				status = "okay";
				spi-max-frequency = <1000000>;
			};
		};
	};

	fragment@1 {
		target = <&spi1>;
		__overlay__ {
			rockchip,pins = <7 8 9 10 11 24>;
			rockchip,function = <0>;
		};
	};
};
